

/ {
    chosen {
        zephyr,console       = &uart0;
        zephyr,shell-uart    = &uart0;
        zephyr,uart-mcumgr   = &uart0;
        zmk,studio-rpc-uart  = &uart0;
        zmk,kscan = &default_kscan;
        zmk,matrix_transform = &default_transform;
    };
    
    default_transform: keymap_transform_0 {
        compatible = "zmk,matrix-transform";
        columns = <1>;
        rows    = <1>;
        map = <
            RC(0,0)
        >;
    };
    
    default_kscan: kscan {
        compatible = "zmk,kscan-gpio-matrix";
        label = "default_kscan";
        diode-direction = "col2row";
        
        row-gpios = <&gpio1 4 GPIO_ACTIVE_HIGH>;
                    
                    
        col-gpios = <&gpio1 6 (GPIO_ACTIVE_HIGH | GPIO_PULL_DOWN)>;
    };
};
