## boards/shields/corne/Kconfig.defconfig
```kconfig
if SHIELD_CORNE_LEFT

config ZMK_KEYBOARD_NAME
    default "Corne_Left"

config ZMK_SPLIT_ROLE_CENTRAL
    default y

config ZMK_STUDIO
    default y

config ZMK_STUDIO
    default y

endif
```

## boards/shields/corne/Kconfig.shield
```kconfig
config CORNE_LEFT
    def_bool $(shields_list_contains,corne_left)

config CORNE_RIGHT
    def_bool $(shields_list_contains,corne_right)
```
